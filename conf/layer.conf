## conf/layer.conf
```bitbake
# We have a conf and classes directory, add to BBPATH
BBPATH .= ":${LAYERDIR}"

BBFILES += "${LAYERDIR}/recipes*/*.bb ${LAYERDIR}/recipes*/*.bbappend ${LAYERDIR}/images/*.bb"

BBFILE_COLLECTIONS += "billiards"
BBFILE_PATTERN_billiards = "^${LAYERDIR}/"
BBFILE_PRIORITY_billiards = "5"
LAYERVERSION_billiards = "1"

LAYERSERIES_COMPAT_billiards = "dunfell"
```
